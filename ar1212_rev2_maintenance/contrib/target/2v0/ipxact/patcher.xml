# u_patcher_registers: IP-XACT component
VLNV spiritconsortium.org:uvm_reg_ex:u_patcher_registers:1685-2009

## Address spaces and blocks
patcher_registers_map.patcher: base 0x0000, range 0x008B, width 32

## Registers
Registers are 32-bit, read-write, reset 0x0 unless marked. A register's access mark holds for its fields unless they carry their own. Offsets are from the block's base; lines under a group give offsets from that group; [hi:lo] are bit positions; {n}, {i} and the like mark numbered series; 'fields as' and 'values as' point back to an identical list; <NAME> marks a mode.

## patcher_registers_map.patcher
Base 0x00000000
{0x0+4i} comparator_{i:02} (i=0..31)
  [31:0] address
0x80 enable
  [31:0] bitmask
0x84 index ro
  [4:0] index
0x88 control
  [0] access_type
